## config/boards/arm/ilich/Kconfig.board
```kconfig
# Skean board configuration

# Copyright (c) 2021 The ZMK Contributors
# SPDX-License-Identifier: MIT

config BOARD_SKEAN_LEFT
	bool "ilich_left"
	depends on SOC_NRF52833_QIAA

config BOARD_SKEAN_RIGHT
	bool "ilich_right"
	depends on SOC_NRF52833_QIAA
```

## config/boards/arm/ilich/Kconfig.defconfig
```kconfig
#
# Copyright (c) 2021 The ZMK Contributors
# SPDX-License-Identifier: MIT
#

if BOARD_ILICH_LEFT

config ZMK_KEYBOARD_NAME
	default "I`lich"

config ZMK_SPLIT_ROLE_CENTRAL
	default y

endif # BOARD_ILICH_LEFT


if BOARD_ILICH_LEFT || BOARD_ILICH_RIGHT

config BOARD
	default "ilich"

config ZMK_SPLIT
	default y

endif # BOARD_ILICH_LEFT || BOARD_ILICH_RIGHT
```

## config/boards/arm/ilich/Kconfig.shield
```kconfig
# Copyright (c) 2021 The ZMK Contributors
# SPDX-License-Identifier: MIT

config SHIELD_ILICH_LEFT
    def_bool $(shields_list_contains,ilich_left)

config SHIELD_ILICH_RIGHT
    def_bool $(shields_list_contains,ilich_right)
```
