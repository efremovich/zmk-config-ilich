## config/west.yml
```yaml
manifest:
  remotes:
    - name: zmkfirmware
      url-base: https://github.com/zmkfirmware
    - name: efremovich
      url-base: https://github.com/efremovich
  projects:
    - name: zmk
      remote: zmkfirmware
      revision: v0.2
      import: app/west.yml
    - name: zmk-config-ilich
      remote: efremovich
      revision: main
  self:
    path: config
```
